## components/mqtt_manager/Kconfig
```kconfig
menu "MQTT Manager"

    config MQTT_BROKER_URI
        string "MQTT Broker URL"
        default "mqtts://mqtt.eclipseprojects.io:8883"

    config MQTT_USERNAME
        string "MQTT username"
        default "myusername"

    config MQTT_PASSWORD
        string "MQTT password"
        default "mypassword"

    config MQTT_NULL_CLIENT_ID
        bool "MQTT null client id"
        default true

    config MQTT_SUB_TOPIC_MAX_LEN
        int "MQTT Subscription Topic String Max Length"
        default 50

endmenu
```

## sdkconfig.defaults
```kconfig
CONFIG_IDF_TARGET="esp32s2"
CONFIG_ESPTOOLPY_FLASHSIZE_4MB=y
CONFIG_EXAMPLE_CONNECT_IPV6=n
CONFIG_SCL_GPIO=9
CONFIG_SDA_GPIO=8
CONFIG_RESET_GPIO=0
```
